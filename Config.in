## package/alsaequal/Config.in
```kconfig
config BR2_PACKAGE_ALSAEQUAL
	bool "alsaequal"
	depends on BR2_INSTALL_LIBSTDCPP
	depends on BR2_TOOLCHAIN_HAS_THREADS # alsa-lib
	select BR2_PACKAGE_ALSA_LIB
	select BR2_PACKAGE_CAPS # Runtime dependency
	help
	  Alsaequal is a real-time adjustable equalizer plugin for ALSA. It
	  can be adjusted using an ALSA compatible mixer, like alsamixergui
	  or alsamixer.

	  Alsaequal uses the Eq CAPS LADSPA Plugin as it's default
	  equalizer.

	  http://www.thedigitalmachine.net/alsaequal.html

comment "alsaequal needs a toolchain w/ C++, threads"
	depends on !BR2_INSTALL_LIBSTDCPP
	depends on !BR2_TOOLCHAIN_HAS_THREADS # alsa-lib
```

## package/jacktrip/Config.in
```kconfig
config BR2_PACKAGE_JACKTRIP
	bool "jacktrip"
    select BR2_PACKAGE_OPENSSL
    select BR2_PACKAGE_QT6
    select BR2_PACKAGE_QT6BASE
    select BR2_PACKAGE_QT6BASE_NETWORK
	help
      Provides JackTrip
```

## package/ladspa/Config.in
```kconfig
config BR2_PACKAGE_LADSPA
	bool "ladspa"
	select BR2_PACKAGE_LIBSNDFILE
	help
      Provides LADSPA support
```

## package/python-osc/Config.in
```kconfig
config BR2_PACKAGE_PYTHON_OSC
	bool "python-osc"
	help
	  OSC implementation for python
```

## package/snappi-cloud-init/Config.in
```kconfig
config BR2_PACKAGE_SNAPPI_CLOUD_INIT
	bool "snappi-cloud-init"
    select BR2_PACKAGE_PYTHON3
    select BR2_PACKAGE_PYTHON_PYYAML
        help
	  Support custom OS settings in the Raspberry Pi Imager
```

## package/snappi-server-config-ui/Config.in
```kconfig
config BR2_PACKAGE_SNAPPI_SERVER_CONFIG_UI
	bool "snappi-server-config-ui"
        help
	  Web-Interface to configure the Snappi Server
```

## package/snappi-server-config/Config.in
```kconfig
config BR2_PACKAGE_SNAPPI_SERVER_CONFIG
	bool "snappi-server-config"
    select BR2_PACKAGE_PYTHON3
    select BR2_PACKAGE_PYTHON3_SSL
    select BR2_PACKAGE_PYTHON_UVICORN
    select BR2_PACKAGE_PYTHON_FASTAPI
    select BR2_PACKAGE_PYTHON_PYYAML
        help
	  Web-Interface and tools to configure the Snappi Server
```

## package/snappi-server-ui/Config.in
```kconfig
config BR2_PACKAGE_SNAPPI_SERVER_UI
	bool "snappi-server-ui"
        help
	  Web-Interface to configure the Snappi Server
```

## package/snappi-users/Config.in
```kconfig
config BR2_PACKAGE_SNAPPI_USERS
	bool "snappi-users"
        help
	  Creates the user that all snappi software runs under
```

## package/snappir-sensor/Config.in
```kconfig
config BR2_PACKAGE_SNAPPIR_SENSOR
	bool "snappir-sensor"
    select BR2_PACKAGE_PYTHON3
        help
	  Snappi Client PIR sensor
```

## package/snappiserver-config/Config.in
```kconfig
config BR2_PACKAGE_SNAPPISERVER_CONFIG
	bool "snappiserver-config"
    select BR2_PACKAGE_PYTHON3
        help
	  Updates the config for all snappi servers on boot
```

## package/snapweb/Config.in
```kconfig
config BR2_PACKAGE_SNAPWEB
	bool "snapweb"
        help
	  Install snapweb for snapserver
```

## snappi-client/Config.in
```kconfig
source "$BR2_EXTERNAL_SNAPPICLIENT_PATH/../package/alsaequal/Config.in"
source "$BR2_EXTERNAL_SNAPPICLIENT_PATH/../package/ladspa/Config.in"
source "$BR2_EXTERNAL_SNAPPICLIENT_PATH/../package/snapcast/Config.in"
source "$BR2_EXTERNAL_SNAPPICLIENT_PATH/../package/snappi-users/Config.in"
source "$BR2_EXTERNAL_SNAPPICLIENT_PATH/../package/snappi-cloud-init/Config.in"
source "$BR2_EXTERNAL_SNAPPICLIENT_PATH/../package/python-osc/Config.in"
```

## snappi-server/Config.in
```kconfig
source "$BR2_EXTERNAL_SNAPPISERVER_PATH/../package/snapcast/Config.in"
source "$BR2_EXTERNAL_SNAPPISERVER_PATH/../package/snapweb/Config.in"
source "$BR2_EXTERNAL_SNAPPISERVER_PATH/../package/jacktrip/Config.in"
source "$BR2_EXTERNAL_SNAPPISERVER_PATH/../package/rtaudio/Config.in"
source "$BR2_EXTERNAL_SNAPPISERVER_PATH/../package/snappi-users/Config.in"
source "$BR2_EXTERNAL_SNAPPISERVER_PATH/../package/snappi-cloud-init/Config.in"
source "$BR2_EXTERNAL_SNAPPISERVER_PATH/../package/snappi-server-config/Config.in"
```

## snappi-server/configs/snappi_server_rpi4_defconfig
```kconfig
BR2_arm=y
BR2_cortex_a72=y
BR2_ARM_FPU_NEON_VFPV4=y
BR2_TOOLCHAIN_EXTERNAL=y
BR2_CCACHE=y
BR2_PACKAGE_OVERRIDE_FILE="$(BR2_EXTERNAL_SNAPPISERVER_PATH)/overrides.mk"
BR2_GLOBAL_PATCH_DIR="$(BR2_EXTERNAL_SNAPPISERVER_PATH)/patches"
BR2_TARGET_GENERIC_HOSTNAME="snappi-server"
BR2_TARGET_GENERIC_ISSUE="Welcome to SnapPi Server"
BR2_PACKAGE_HOST_LINUX_HEADERS_CUSTOM_6_6=y
BR2_INIT_SYSTEMD=y
BR2_ROOTFS_DEVICE_TABLE="system/device_table.txt $(BR2_EXTERNAL_SNAPPISERVER_PATH)/board/common/device_table.txt"
BR2_TARGET_GENERIC_ROOT_PASSWD="root"
BR2_SYSTEM_DEFAULT_PATH="/bin:/sbin:/usr/bin:/usr/sbin"
BR2_ROOTFS_OVERLAY="$(BR2_EXTERNAL_SNAPPISERVER_PATH)/rootfs"
BR2_ROOTFS_POST_BUILD_SCRIPT="$(BR2_EXTERNAL_SNAPPISERVER_PATH)/board/common/post-build.sh board/raspberrypi4/post-build.sh"
BR2_ROOTFS_POST_IMAGE_SCRIPT="$(BR2_EXTERNAL_SNAPPISERVER_PATH)/board/common/post-image.sh board/raspberrypi4/post-image.sh"
BR2_ROOTFS_POST_SCRIPT_ARGS="--mount-boot --hostname-from-env"
BR2_LINUX_KERNEL=y
BR2_LINUX_KERNEL_CUSTOM_TARBALL=y
BR2_LINUX_KERNEL_CUSTOM_TARBALL_LOCATION="$(call github,raspberrypi,linux,576cc10e1ed50a9eacffc7a05c796051d7343ea4)/linux-576cc10e1ed50a9eacffc7a05c796051d7343ea4.tar.gz"
BR2_LINUX_KERNEL_DEFCONFIG="bcm2711"
BR2_LINUX_KERNEL_CONFIG_FRAGMENT_FILES="$(BR2_EXTERNAL_SNAPPISERVER_PATH)/board/rpi4/linux.config.fragment"
BR2_LINUX_KERNEL_DTS_SUPPORT=y
BR2_LINUX_KERNEL_INTREE_DTS_NAME="broadcom/bcm2711-rpi-4-b broadcom/bcm2711-rpi-400 broadcom/bcm2711-rpi-cm4 broadcom/bcm2711-rpi-cm4s"
BR2_LINUX_KERNEL_NEEDS_HOST_OPENSSL=y
BR2_PACKAGE_ALSA_UTILS=y
BR2_PACKAGE_ALSA_UTILS_APLAY=y
BR2_PACKAGE_JACK2=y
BR2_PACKAGE_PIPEWIRE=y
BR2_PACKAGE_WIREPLUMBER=y
BR2_PACKAGE_XZ=y
BR2_PACKAGE_BRCMFMAC_SDIO_FIRMWARE_RPI=y
BR2_PACKAGE_BRCMFMAC_SDIO_FIRMWARE_RPI_WIFI=y
BR2_PACKAGE_LINUX_FIRMWARE=y
BR2_PACKAGE_LINUX_FIRMWARE_MEDIATEK_MT7601U=y
BR2_PACKAGE_LINUX_FIRMWARE_MEDIATEK_MT7610E=y
BR2_PACKAGE_LINUX_FIRMWARE_MEDIATEK_MT76X2E=y
BR2_PACKAGE_RPI_FIRMWARE=y
BR2_PACKAGE_RPI_FIRMWARE_VARIANT_PI4=y
BR2_PACKAGE_RPI_FIRMWARE_CONFIG_FILE="$(BR2_EXTERNAL_SNAPPISERVER_PATH)/board/rpi4/config.txt"
BR2_PACKAGE_KMOD=y
BR2_PACKAGE_KMOD_TOOLS=y
BR2_PACKAGE_RTL8821CU=y
BR2_PACKAGE_LUA=y
BR2_PACKAGE_ELL=y
BR2_PACKAGE_NCURSES_WCHAR=y
BR2_PACKAGE_DNSMASQ=y
# BR2_PACKAGE_DNSMASQ_TFTP is not set
BR2_PACKAGE_DROPBEAR=y
# BR2_PACKAGE_DROPBEAR_CLIENT is not set
BR2_PACKAGE_DROPBEAR_DISABLE_REVERSEDNS=y
BR2_PACKAGE_DROPBEAR_LEGACY_CRYPTO=y
BR2_PACKAGE_IPTABLES=y
BR2_PACKAGE_NETWORK_MANAGER=y
BR2_PACKAGE_NETWORK_MANAGER_CLI=y
BR2_PACKAGE_RSYNC=y
BR2_PACKAGE_WPA_SUPPLICANT=y
BR2_PACKAGE_WPA_SUPPLICANT_AP_SUPPORT=y
BR2_PACKAGE_WPA_SUPPLICANT_CLI=y
BR2_PACKAGE_WPA_SUPPLICANT_DBUS=y
BR2_PACKAGE_HTOP=y
# BR2_PACKAGE_SYSTEMD_NETWORKD is not set
BR2_PACKAGE_NANO=y
BR2_TARGET_ROOTFS_EXT2=y
BR2_TARGET_ROOTFS_EXT2_4=y
BR2_TARGET_ROOTFS_EXT2_SIZE="250M"
# BR2_TARGET_ROOTFS_TAR is not set
BR2_PACKAGE_HOST_DOSFSTOOLS=y
BR2_PACKAGE_HOST_GENIMAGE=y
BR2_PACKAGE_HOST_KMOD_XZ=y
BR2_PACKAGE_HOST_MTOOLS=y
BR2_PACKAGE_SNAPCAST=y
# BR2_PACKAGE_SNAPCAST_CLIENT is not set
BR2_PACKAGE_SNAPCAST_SERVER=y
BR2_PACKAGE_SNAPWEB=y
BR2_PACKAGE_JACKTRIP=y
BR2_PACKAGE_SNAPPI_USERS=y
BR2_PACKAGE_SNAPPI_SERVER_CONFIG=y
BR2_PACKAGE_SNAPPI_SERVER_CONFIG_UI=y
```
